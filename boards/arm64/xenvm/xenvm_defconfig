## boards/arm64/xenvm/xenvm_defconfig
```kconfig
CONFIG_SOC_XENVM=y
CONFIG_BOARD_XENVM=y
CONFIG_XEN_INITIAL_DOMAIN=y

# Enable UART driver
CONFIG_SERIAL=y

CONFIG_MAX_XLAT_TABLES=10
CONFIG_HEAP_MEM_POOL_SIZE=1048576

# Enable console
CONFIG_CONSOLE=y
CONFIG_UART_CONSOLE=y

# Enable PV hypervisor console
#CONFIG_UART_CONSOLEIO_XEN_HVC=y

# Enable logging subsys
CONFIG_LOG=y
CONFIG_LOG_MODE_MINIMAL=y

CONFIG_TEST=y
#CONFIG_PRINTK_SYNC=y

CONFIG_SHELL=y
CONFIG_SHELL_BACKEND_SERIAL=y

CONFIG_DEBUG_INFO=y

CONFIG_OVERRIDE_FRAME_POINTER_DEFAULT=y
CONFIG_OMIT_FRAME_POINTER=n

CONFIG_MAIN_STACK_SIZE=32768
CONFIG_IDLE_STACK_SIZE=32768
CONFIG_ISR_STACK_SIZE=32768
CONFIG_SYSTEM_WORKQUEUE_STACK_SIZE=32768
CONFIG_CMSIS_THREAD_MAX_STACK_SIZE=32768
CONFIG_CMSIS_V2_THREAD_MAX_STACK_SIZE=32768
CONFIG_CMSIS_V2_THREAD_DYNAMIC_STACK_SIZE=32768
CONFIG_IPM_CONSOLE_STACK_SIZE=32768
CONFIG_PRIVILEGED_STACK_SIZE=32768
CONFIG_SHELL_STACK_SIZE=32768
```
